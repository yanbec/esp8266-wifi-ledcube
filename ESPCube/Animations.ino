extern int currentAnimationStep;
extern int currentAnimationMaxSteps;

void turnCubeOff() {
  currentAnimationMaxSteps = 1;
  byte fr0[] = { 0xF2,
                 0x00, 0x00, 0x00, 0x00, 0x00, 0x00, 0x00, 0x00,
                 0x00, 0x00, 0x00, 0x00, 0x00, 0x00, 0x00, 0x00,
                 0x00, 0x00, 0x00, 0x00, 0x00, 0x00, 0x00, 0x00,
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                 0x00, 0x00, 0x00, 0x00, 0x00, 0x00, 0x00, 0x00
               };

  for (int i = 0; i < 65; i++)
    Serial.write(fr0[i]);
}

void turnCubeFullOn() {
  currentAnimationMaxSteps = 1;
  byte fr0[] = { 0xF2,
                 0xFF, 0xFF, 0xFF, 0xFF, 0xFF, 0xFF, 0xFF, 0xFF,
                 0xFF, 0xFF, 0xFF, 0xFF, 0xFF, 0xFF, 0xFF, 0xFF,
                 0xFF, 0xFF, 0xFF, 0xFF, 0xFF, 0xFF, 0xFF, 0xFF,
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                 0xFF, 0xFF, 0xFF, 0xFF, 0xFF, 0xFF, 0xFF, 0xFF
               };

  for (int i = 0; i < 65; i++)
    Serial.write(fr0[i]);
}


void rotateTower(bool left) {
  currentAnimationMaxSteps = 4;
  byte frames[][65] = {
    { 0xF2,
      0x00, 0x00, 0x00, 0x00, 0xF0, 0xF0, 0xF0, 0xF0,
      0x00, 0x00, 0x00, 0x00, 0xF0, 0xF0, 0xF0, 0xF0,
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      0x00, 0x00, 0x00, 0x00, 0xF0, 0xF0, 0xF0, 0xF0
    },
    { 0xF2,
      0xF0, 0xF0, 0xF0, 0xF0, 0x00, 0x00, 0x00, 0x00,
      0xF0, 0xF0, 0xF0, 0xF0, 0x00, 0x00, 0x00, 0x00,
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      0xF0, 0xF0, 0xF0, 0xF0, 0x00, 0x00, 0x00, 0x00
    },

    { 0xF2,
      0x0F, 0x0F, 0x0F, 0x0F, 0x00, 0x00, 0x00, 0x00,
      0x0F, 0x0F, 0x0F, 0x0F, 0x00, 0x00, 0x00, 0x00,
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      0x0F, 0x0F, 0x0F, 0x0F, 0x00, 0x00, 0x00, 0x00
    },

    { 0xF2,
      0x00, 0x00, 0x00, 0x00, 0x0F, 0x0F, 0x0F, 0x0F,
      0x00, 0x00, 0x00, 0x00, 0x0F, 0x0F, 0x0F, 0x0F,
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      0x00, 0x00, 0x00, 0x00, 0x0F, 0x0F, 0x0F, 0x0F
    }
  };

  if (left) {
    delay(300);

    for (int i = 0; i < 65; i++)
      Serial.write(frames[currentAnimationStep][i]);
  }
  else
  {
    delay(300);

    for (int i = 0; i < 65; i++)
      Serial.write(frames[abs(currentAnimationStep - 3)][i]);
  }
}

void doWave() {

}

void doRandom() {
  Serial.write(0xF2);
  for (int i = 0; i < 64; i++) {
    Serial.write((byte) random(0, 0xFF));
  }
  delay(random(1,1000));
}

void doTest() {
  currentAnimationMaxSteps = 40;
  byte frame[] = {
    0xf2,
    0x0F, 0x0F, 0x0F, 0x0F, 0x0F, 0x0F, 0x0F, 0x0F,
    0x00, 0x00, 0x00, 0x00, 0x00, 0x00, 0x00, 0x00,
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    0x00, 0x00, 0x00, 0x00, 0x00, 0x00, 0x00, 0x00
  };

  for (int i = 0; i < 65; i++)
    Serial.write(frame[i]);  frame[1] = 2;
}

void doBinaryFront() {
  currentAnimationMaxSteps = 256;
  byte frame[] = {
    0xf2,
    0x00, 0x00, 0x00, 0x00, 0x00, 0x00, 0x00, 0x00,
    0x00, 0x00, 0x00, 0x00, 0x00, 0x00, 0x00, 0x00,
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    0x00, 0x00, 0x00, 0x00, 0x00, 0x00, 0x00, 0x00
  };
  for (int i = 1; i < 65; i += 8)
    frame[i] += currentAnimationStep;

  for (int i = 0; i < 65; i++)
    Serial.write(frame[i]);
}

void doFence() {
  currentAnimationMaxSteps = 28;
  byte frame[] = {
    0xf2,
    0x00, 0x00, 0x00, 0x00, 0x00, 0x00, 0x00, 0x00,
    0x00, 0x00, 0x00, 0x00, 0x00, 0x00, 0x00, 0x00,
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    0x00, 0x00, 0x00, 0x00, 0x00, 0x00, 0x00, 0x00
  };
  if (currentAnimationStep < 7)
    for (int i = 1; i < 65; i += 8)
      frame[i] = (byte) pow(2, currentAnimationStep);

  else if (currentAnimationStep < 14)
    for (int i = 2 + (currentAnimationStep - 8); i < 65; i += 8)
      frame[i] = 128;

  else if (currentAnimationStep < 21)
    for (int i = 8; i < 65; i += 8)
      frame[i] = (byte) 128 / pow(2, currentAnimationStep - 14);

  else if (currentAnimationStep < 28)
    for (int i = 8 - (currentAnimationStep - 21); i > 0; i -= 8)
      for (int j = 0; j < 8; j++)
        frame[i + 8 * j] = 1;

  for (int i = 0; i < 65; i++)
    Serial.write(frame[i]);
}

void doSignalLight() {
  currentAnimationMaxSteps = 2;
  //60/80/250
  byte frameRight[] = { 0xf2,
                        0x0F, 0x0F, 0x0F, 0x0F, 0x0F, 0x0F, 0x0F, 0x0F,
                        0x0F, 0x0F, 0x0F, 0x0F, 0x0F, 0x0F, 0x0F, 0x0F,
                        0x0F, 0x0F, 0x0F, 0x0F, 0x0F, 0x0F, 0x0F, 0x0F,
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                        0x0F, 0x0F, 0x0F, 0x0F, 0x0F, 0x0F, 0x0F, 0x0F
                      };

  byte frameLeft[] = { 0xf2,
                       0xF0, 0xF0, 0xF0, 0xF0, 0xF0, 0xF0, 0xF0, 0xF0,
                       0xF0, 0xF0, 0xF0, 0xF0, 0xF0, 0xF0, 0xF0, 0xF0,
                       0xF0, 0xF0, 0xF0, 0xF0, 0xF0, 0xF0, 0xF0, 0xF0,
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                       0xF0, 0xF0, 0xF0, 0xF0, 0xF0, 0xF0, 0xF0, 0xF0
                     };

  byte frameOff[] = { 0xf2,
                      0x00, 0x00, 0x00, 0x00, 0x00, 0x00, 0x00, 0x00,
                      0x00, 0x00, 0x00, 0x00, 0x00, 0x00, 0x00, 0x00,
                      0x00, 0x00, 0x00, 0x00, 0x00, 0x00, 0x00, 0x00,
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                      0x00, 0x00, 0x00, 0x00, 0x00, 0x00, 0x00, 0x00
                    };
  if (currentAnimationStep == 0) {
    for (int i = 0; i < 65; i++)
      Serial.write(frameRight[i]);
    delay(random(50,90));
    for (int i = 0; i < 65; i++)
      Serial.write(frameOff[i]);
    delay(80);
    for (int i = 0; i < 65; i++)
      Serial.write(frameRight[i]);
    delay(60);
    for (int i = 0; i < 65; i++)
      Serial.write(frameOff[i]);
    delay(random(100,300));
  }
  else {
    for (int i = 0; i < 65; i++)
      Serial.write(frameLeft[i]);
    delay(random(50,90));
    for (int i = 0; i < 65; i++)
      Serial.write(frameOff[i]);
    delay(80);
    for (int i = 0; i < 65; i++)
      Serial.write(frameLeft[i]);
    delay(60);
    for (int i = 0; i < 65; i++)
      Serial.write(frameOff[i]);
    delay(random(100,300));
  }
}


